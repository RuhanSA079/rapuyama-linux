/* Diagnostic image: keep the existing VideoCore framebuffer outside Linux RAM. */
/include/ "e6-usb.dts"

/ {
	chosen {
		bootargs = "earlycon=ramcon,0x1f000000 keep_bootcon console=ttyGS0,115200 panic=10 nohlt e6.usbsh e6.fbtest";
	};
};

/ {
	/*
	 * NOT under /reserved-memory: with PHYS_OFFSET=0x10a00000 this range is
	 * already outside Linux RAM, and a reserved-memory node below
	 * PHYS_OFFSET broke paging_init ("BUG: not creating mapping for
	 * 0x00000000 at 0xaf600000"). A plain node without "compatible" is not
	 * probed; the fb driver only reads its reg via the memory-region phandle.
	 */
	display_fb: framebuffer-mem@10480000 {
		reg = <0x10480000 0x00400000>;
	};

	rapuyama_fb {
		compatible = "nokia,rapuyama-fbmem";
		memory-region = <&display_fb>;
		width = <640>;
		height = <480>;
		stride = <2560>;
		bits-per-pixel = <32>;
		status = "okay";
	};
};
