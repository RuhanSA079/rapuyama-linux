/* first boot on the nokia n8 (same rapuyama soc as the e6, untested there):
 * usb shell + ram log only. no display, no i2c chips (the e6 keypad/touch
 * addresses may be something else on this board), no swd (its addresses come
 * from the e6 firmware), no rootfs on the card */
/include/ "e6-usb.dts"

/ {
	compatible = "nokia,n8", "nokia,rapuyama";
	model = "Nokia N8-00 (RapuYama)";

	chosen {
		bootargs = "earlycon=ramcon,0x1f000000 keep_bootcon console=ttyNULL panic=10 nohlt clk_ignore_unused pd_ignore_unused cma=0 e6.usbsh";
	};
};

&i2c0 {
	status = "disabled";
};

/* 4th reg: the startup mode word. rebootdriver.ldd sets bits 20-23 before
 * the soc reset; left at 0 the n8 powers off instead of booting symbian,
 * 0xe (normal restart) brings it back (23.10.2026) */
&{/soc/watchdog@20030700} {
	reg = <0x20030700 0x40>, <0x200336c4 0x4>, <0x20033114 0x4>,
	      <0x20040400 0x4>;
};