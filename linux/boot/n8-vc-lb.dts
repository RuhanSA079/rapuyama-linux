/* n8-vc.dts with the other VideoCore loader. vcdriver.dll builds two image
 * sets, each one loader + vc-main: {0x802f0a40, main} and {0x802ee9c0,
 * main}. loader A (0x802ee9c0) got "loader answered 1/1" and the bring-up
 * timed out (-11) on the n8 (23.10.2026), so try 0x802f0a40 (vc-loader-b) */
/include/ "n8-vc.dts"

/ {
	chosen {
		bootargs = "earlycon=ramcon,0x1f000000 keep_bootcon console=tty0 panic=10 nohlt clk_ignore_unused pd_ignore_unused cma=0 e6.usbsh videocore.debug=2 videocore.loader_b=1";
	};
};
