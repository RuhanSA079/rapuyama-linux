/* e6-vc-565 + videocore.khrn_probe=1 (khronos services in dmesg) +
 * videocore.disp_probe=1 (the screen moves down 2 s, scrolls up 2 s) */
/include/ "e6-vc.dts"

/ {
	chosen {
		bootargs = "earlycon=ramcon,0x1f000000 keep_bootcon console=tty0 panic=10 nohlt clk_ignore_unused pd_ignore_unused cma=0 e6.usbsh e6.fbtest videocore.dma=1 videocore.rgb565=1 videocore.khrn_probe=1 videocore.disp_probe=1";
	};
};